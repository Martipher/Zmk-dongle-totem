## config/west.yml
```yaml
manifest:
  remotes:
    - name: zmkfirmware
      url-base: https://github.com/zmkfirmware
    - name: azumafuji
      url-base: https://github.com/azumafuji
    - name: janpfisher
      url-base: https://github.com/martipher
  projects:
    - name: zmk
      remote: zmkfirmware
      revision: main
      import: app/west.yml
    - name: zmk-dongle-screen
      remote: martipher
      revision: upgrade-4.1
  self:
    path: config
```
